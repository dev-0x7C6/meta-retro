## conf/distro/include/retro-arm-familly.inc
```bitbake
MESA_ARM_PREFERRED_DRIVERS ?= "etnaviv freedreno lima panfrost"

DISTROOVERRIDES:append:aarch64 = ":arm-common"
DISTROOVERRIDES:append:aarch64_be = ":arm-common"
DISTROOVERRIDES:append:arm = ":arm-common"
DISTROOVERRIDES:append:armeb = ":arm-common"

PACKAGECONFIG:append:pn-mesa:arm-common = " ${MESA_ARM_PREFERRED_DRIVERS}"
PACKAGECONFIG:remove:pn-mesa:arm-common = "va vdpau"

VAAPISUPPORT:arm-common = "0"
VDPAUSUPPORT:arm-common = "0"
```

## conf/distro/include/retro-common.inc
```bitbake
MAINTAINER = "Bartłomiej Burdukiewicz <bartlomiej.burdukiewicz@gmail.com>"

RETRO_FEATURES ?= "retroarch-automount retroarch-autostart retroarch-firmware retroarch-gles retroarch-gles3"

DISTRO_FEATURES_BACKFILL:remove = "pulseaudio gobject-introspection-data ldconfig"
DISTRO_FEATURES_BACKFILL_CONSIDERED = "sysvinit"

VIRTUAL-RUNTIME_init_manager = "systemd"
VIRTUAL-RUNTIME_initscripts = "systemd-compat-units"

DISTROOVERRIDES:prepend = "${@bb.utils.contains('DISTRO_FEATURES', 'rauc', 'rauc-integration:', '', d)}"

SANITY_TESTED_DISTROS:append = "gentoo \n"
```

## conf/distro/include/retro-raspberrypi.inc
```bitbake
MACHINEOVERRIDES =. "${@bb.utils.contains('MACHINE_FEATURES', 'full-kms', 'full-kms:', '', d)}"

RPI_ALWAYS_FULLHD ?= "1"
RPI_ENABLE_AUDIO ?= "1"
RPI_V4L2M2M_DECODER ?= "1"

MESA_ARM_PREFERRED_DRIVERS:rpi = ""
PACKAGECONFIG:append:pn-mesa:rpi = " v3d vc4"

RPI_KERNEL_DEVICETREE_OVERLAYS:append:rpi:full-kms = " overlays/cma.dtbo overlays/vc4-kms-v3d-pi4.dtbo overlays/rpivid-v4l2.dtbo"

VC4_DTBO_VARIANT = "vc4-kms-v3d"
VC4_DTBO_VARIANT:raspberrypi4 = "vc4-kms-v3d-pi4,cma-320"
VC4_DTBO_VARIANT:raspberrypi4-64 = "vc4-kms-v3d-pi4,cma-320"

VC4DTBO:rpi:full-kms = "${VC4_DTBO_VARIANT}"

# vc4-hdmi driver do not support audio mixing
DISTRO_FEATURES:append:rpi:full-kms = " pulseaudio"
```

## conf/distro/include/retro-x86-familly.inc
```bitbake
RETROARCH_PREFERRED_KERNEL_FOR_X86 ?= "linux-yocto"

DISTROOVERRIDES:append:x86 = ":x86-common"
DISTROOVERRIDES:append:x86-64 = ":x86-common"
#RETRO_FEATURES:append:x86-common = " retroarch-opengl"

PREFERRED_PROVIDER:virtual/kernel:x86-common = "${RETROARCH_PREFERRED_KERNEL_FOR_X86}"

MESA_X86_PREFERRED_DRIVERS ?= "gallium gallium-llvm r600"

PACKAGECONFIG:append:pn-mesa:x86-common = " ${MESA_X86_PREFERRED_DRIVERS}"
```

## conf/distro/retro-nano.conf
```bitbake
require conf/distro/poky.conf
require conf/distro/include/retro-arm-familly.inc
require conf/distro/include/retro-common.inc
require conf/distro/include/retro-raspberrypi.inc
require conf/distro/include/retro-x86-familly.inc

DISTRO = "retro-nano"
DISTRO_NAME = "Retro (nano)"

DISTROOVERRIDES = "retro:retro-nano"

DISTRO_FEATURES = "alsa opengl systemd vulkan ${RETRO_FEATURES}"
```

## conf/distro/retro-wayland.conf
```bitbake
require conf/distro/poky.conf
require conf/distro/include/retro-arm-familly.inc
require conf/distro/include/retro-common.inc
require conf/distro/include/retro-raspberrypi.inc
require conf/distro/include/retro-x86-familly.inc

DISTRO = "retro-wayland"
DISTRO_NAME = "Retro (wayland)"

PREPARE_DISTRO_FEATURES = " \
   ${RETRO_FEATURES} \
   acl \
   alsa \
   bluetooth \
   ext2 \
   gobject-introspection-data \
   gtk+3 \
   ipv4 \
   ipv6 \
   largefile \
   nfs \
   opengl \
   pam \
   polkit \
   pulseaudio \
   samba \
   systemd \
   vulkan \
   wayland \
   wifi \
   x11 \
   zeroconf \
"

DISTRO_FEATURES = "${@' '.join(sorted('${PREPARE_DISTRO_FEATURES}'.split()))}"

# Replace busybox
PREFERRED_PROVIDER_virtual/base-utils = "coreutils"
VIRTUAL-RUNTIME_base-utils = "coreutils"
VIRTUAL-RUNTIME_base-utils-hwclock = "util-linux-hwclock"
VIRTUAL-RUNTIME_base-utils-syslog = ""

# Use systemd for system initialization
VIRTUAL-RUNTIME_login_manager = "systemd"
VIRTUAL-RUNTIME_dev_manager = "systemd"
```

## conf/distro/retro.conf
```bitbake
require conf/distro/poky.conf
require conf/distro/include/retro-arm-familly.inc
require conf/distro/include/retro-common.inc
require conf/distro/include/retro-raspberrypi.inc
require conf/distro/include/retro-x86-familly.inc

DISTRO = "retro"
DISTRO_NAME = "Retro"

DISTRO_FEATURES = "acl alsa bluetooth ext2 ipv4 ipv6 kodi largefile opengl pam rauc systemd vulkan wifi ${RETRO_FEATURES}"
```

## conf/layer.conf
```bitbake
# We have a conf and classes directory, append to BBPATH
BBPATH .= ":${LAYERDIR}"

# We have a recipes directory, add to BBFILES
BBFILES += " \
	${LAYERDIR}/recipes*/*/*.bb \
	${LAYERDIR}/recipes*/*/*.bbappend \
	${LAYERDIR}/recipes*/*/*/*.bb \
	${LAYERDIR}/recipes*/*/*/*.bbappend \
"

BBFILE_COLLECTIONS += "meta-libretro"
BBFILE_PATTERN_meta-libretro := "^${LAYERDIR}/"
BBFILE_PRIORITY_meta-libretro = "100"

LAYERSERIES_COMPAT_meta-libretro = "warrior zeus dunfell gatesgarth hardknott"

# Additional license directories.
LICENSE_PATH += "${LAYERDIR}/files/custom-licenses"

RETRO_LICENSE_DIR = "${LAYERDIR}/files/custom-licenses"

LAYERDEPENDS_meta-libretro = " \
    core \
    meta-python2 \
    multimedia-layer \
    networking-layer \
    openembedded-layer \
    qt5-layer \
"

LAYERRECOMMENDS_meta-libretro = " \
    intel \
    meta-kodi \
    meta-raspberrypi-extras \
    raspberrypi \
"

# The dynamic-layers directory hosts the extensions and layer specific
# modifications.
#
# The .bbappend and .bb files are included if the respective layer
# collection is available.

BBFILES += "${@' '.join('${LAYERDIR}/dynamic-layers/%s/recipes*/*/*.bbappend' % layer \
               for layer in BBFILE_COLLECTIONS.split())}"
BBFILES += "${@' '.join('${LAYERDIR}/dynamic-layers/%s/recipes*/*/*.bb' % layer \
               for layer in BBFILE_COLLECTIONS.split())}"

BBFILES_DYNAMIC += " \
    meta-kodi:${LAYERDIR}/dynamic-layers/meta-kodi/*/*/*.bb \
    meta-kodi:${LAYERDIR}/dynamic-layers/meta-kodi/*/*/*.bb \
    qt5-layer:${LAYERDIR}/dynamic-layers/meta-qt5/*/*/*.bb \
    qt5-layer:${LAYERDIR}/dynamic-layers/meta-qt5/*/*/*.bbappend \
    raspberrypi:${LAYERDIR}/dynamic-layers/meta-raspberrypi/*/*/*.bb \
    raspberrypi:${LAYERDIR}/dynamic-layers/meta-raspberrypi/*/*/*.bbappend \
    rauc:${LAYERDIR}/dynamic-layers/meta-rauc/*/*/*.bb \
    rauc:${LAYERDIR}/dynamic-layers/meta-rauc/*/*/*.bbappend \
"
```

## wic/retro-rpi-sdimage.wks
```
# short-description: Raspberry Pi Retro Image

part /boot --source bootimg-partition --ondisk mmcblk0 --fstype=vfat --label boot --active --align 4096 --size 20
part / --source rootfs --ondisk mmcblk0 --fstype=ext4 --label root --align 4096
```

## wic/retro-systemd-bootdisk.wks
```
# short-description: Create an EFI disk image with systemd-boot
# long-description: Creates a partitioned EFI disk image that the user
# can directly dd to boot media. The selected bootloader is systemd-boot.

part /boot --source bootimg-efi --sourceparams="loader=systemd-boot" --label msdos --active --align 4096 --use-uuid
part / --source rootfs --fstype=ext4 --label platform --align 4096 --use-uuid --exclude-path=home/
part /home --source rootfs --change-directory=home --fstype=ext4 --use-uuid --label homefs --align 4096 --size 256

bootloader --ptable gpt --timeout=5 --append="rootwait rootfstype=ext4 console=ttyS0,115200 console=tty0"
```

## wic/sdimage-dual-raspberrypi-retro.wks
```
# short-description: Create Raspberry Pi SD card image suitable for Retro distro with rauc

part /boot --source bootimg-partition --ondisk mmcblk0 --fstype=vfat --label boot --active --align 4096 --size 20

# Setup for rootfs A/B
part / --source rootfs --ondisk mmcblk0 --fstype=ext4 --label rootfs.0 --align 4096
part / --source rootfs --ondisk mmcblk0 --fstype=ext4 --label rootfs.1 --align 4096

#BUG: --exclude-path=home/ make everything owned by 1000:1000 in rootfs
#BUG: https://bugzilla.yoctoproject.org/show_bug.cgi?id=14129

# Partition for application and user data
part /home --source rootfs --change-directory=home --ondisk mmcblk0 --fstype=ext4 --label homefs --align 4096 --size 256
```
